## Kconfig
```kconfig
# Copyright (c) 2024 Realtek Semiconductor, Inc.
# SPDX-License-Identifier: Apache-2.0

rsource "drivers/Kconfig"
rsource "lib/Kconfig"
```

## drivers/Kconfig
```kconfig
# Copyright (c) 2024 Realtek Semiconductor, Inc.
# SPDX-License-Identifier: Apache-2.0

menu "Drivers"

rsource "clock_control/Kconfig"
rsource "gpio/Kconfig"
rsource "pinctrl/Kconfig"
rsource "reset/Kconfig"
rsource "watchdog/Kconfig"

endmenu
```

## drivers/clock_control/Kconfig
```kconfig
# Copyright (c) 2024 Realtek Semiconductor, Inc.
# SPDX-License-Identifier: Apache-2.0

if CLOCK_CONTROL

rsource "./Kconfig.rts5817"

endif
```

## drivers/entropy/Kconfig
```kconfig
# Copyright (c) 2024 Realtek Semiconductor, Inc.
# SPDX-License-Identifier: Apache-2.0

if ENTROPY_GENERATOR

rsource "./Kconfig.rts5817"

endif
```

## drivers/flash/Kconfig
```kconfig
# Copyright (c) 2024 Realtek Semiconductor, Inc.
# SPDX-License-Identifier: Apache-2.0

if FLASH

rsource "./Kconfig.rts5817"

endif
```

## drivers/pinctrl/Kconfig
```kconfig
# Copyright (c) 2024 Realtek Semiconductor, Inc.
# SPDX-License-Identifier: Apache-2.0

if PINCTRL

rsource "./Kconfig.rts5817"

endif
```

## drivers/regulator/Kconfig
```kconfig
# Copyright (c) 2024 Realtek Semiconductor, Inc.
# SPDX-License-Identifier: Apache-2.0

if REGULATOR

rsource "./Kconfig.rts5817"

endif
```

## drivers/spi/Kconfig
```kconfig
# Copyright (c) 2024 Realtek Semiconductor, Inc.
# SPDX-License-Identifier: Apache-2.0

if SPI

rsource "./Kconfig.rts5817"

endif
```
